## examples/read_voltage/sdkconfig.defaults
```kconfig
CONFIG_ESP_MAIN_TASK_STACK_SIZE=3000
CONFIG_ESP_TASK_WDT=n
CONFIG_IDF_TARGET="esp32s3"
CONFIG_I2C_MASTER_SCL=11
CONFIG_I2C_MASTER_SDA=12
```

## test_app/main/Kconfig.projbuild
```kconfig
menu "INA226 Hardware Test"

    config INA226_TEST_I2C_SCL
        int "I2C SCL GPIO"
        default 11
        help
            GPIO connected to the INA226 SCL line.

    config INA226_TEST_I2C_SDA
        int "I2C SDA GPIO"
        default 12
        help
            GPIO connected to the INA226 SDA line.

    config INA226_TEST_EXPECTED_BUS_VOLTAGE_MV
        int "Expected bus voltage in mV"
        default 24000
        help
            Nominal voltage supplied to the INA226 bus input.

    config INA226_TEST_BUS_VOLTAGE_TOLERANCE_MV
        int "Bus voltage tolerance in mV"
        default 500
        help
            Permitted deviation from the expected bus voltage.

endmenu
```

## test_app/sdkconfig.defaults
```kconfig
CONFIG_IDF_TARGET="esp32s3"
CONFIG_ESP_TASK_WDT_EN=n
CONFIG_INA226_TEST_I2C_SCL=11
CONFIG_INA226_TEST_I2C_SDA=12
CONFIG_INA226_TEST_EXPECTED_BUS_VOLTAGE_MV=24000
CONFIG_INA226_TEST_BUS_VOLTAGE_TOLERANCE_MV=500
```
